## src/esp32/Kconfig
```kconfig
# Kconfig settings for ESP processors

if MACH_ESP32

config BOARD_DIRECTORY
    string
    default "esp32"

choice
    prompt "Processor model"
    config MACH_esp32wroom32
        bool "esp32wroom32"
endchoice

config MCU
    string
    default "esp32" if MACH_esp32wroom32

config MAX_TASK_NAME_LEN
    int
    default 16

config TASK_NOTIFICATION_ARRAY_ENTRIES
    int
    default 1

config CLOCK_FREQ
    int
    default 1000000

config SERIAL_BAUD
    int
    default 250000

endif
```
